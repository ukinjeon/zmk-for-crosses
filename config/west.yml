## config/west.yml
```yaml
manifest:
  defaults:
    revision: main
  remotes:
    - name: zmkfirmware
      url-base: https://github.com/zmkfirmware
    - name: Good-Great-Grand-Wonderful
      url-base: https://github.com/Good-Great-Grand-Wonderful
    - name: HeeTuic
      url-base: https://github.com/HeeTuic
  projects:
    - name: zmk
      remote: zmkfirmware
      revision: ac7f75b8591d39aaf3b66b9d26f26c9ed921a009
      import: app/west.yml
    - name: cb-zmk-keebs
      remote: HeeTuic
      revision: zephyr-4.1
      import: config/west.yml
  self:
    path: config
```
